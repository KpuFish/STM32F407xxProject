#include "usart_task.h"

///////////////////////////////////////////////////////////////////////////////
//////函		数：
//////功		能：
//////输入参数:
//////输出参数:
//////说		明：
//////////////////////////////////////////////////////////////////////////////
UINT8_T  USARTTask_Init(USART_HandlerType*  USARTx, UINT16_T rxSize, UINT8_T* pRxVal, UINT8_T rxCRCFlag, UINT16_T txSize, UINT8_T* pTxVal, UINT8_T txCRCFlag, UINT32_T(*sysTickFunc)(void))
{
	return USARTLib_Init(USARTx, rxSize, pRxVal, rxCRCFlag, txSize, pTxVal, txCRCFlag, sysTickFunc);
}

///////////////////////////////////////////////////////////////////////////////
//////函		数：
//////功		能：
//////输入参数:
//////输出参数:
//////说		明：
//////////////////////////////////////////////////////////////////////////////
UINT8_T  USARTTask_DeInit(USART_HandlerType*  USARTx)
{
	return USARTLib_DeInit(USARTx);
}

///////////////////////////////////////////////////////////////////////////////
//////函		数：
//////功		能：
//////输入参数:
//////输出参数:
//////说		明：
//////////////////////////////////////////////////////////////////////////////
UINT8_T  USARTTask_WriteData8Bits(USART_HandlerType*USARTx, UINT8_T val)
{
	return USARTLib_WriteData8Bits(USARTx, val);
}

///////////////////////////////////////////////////////////////////////////////
//////函		数：
//////功		能：
//////输入参数:
//////输出参数:
//////说		明：
//////////////////////////////////////////////////////////////////////////////
UINT8_T  USARTTask_ReadData8Bits(USART_HandlerType*USARTx)
{
	return USARTLib_ReadData8Bits(USARTx);
}

///////////////////////////////////////////////////////////////////////////////
//////函		数：
//////功		能：
//////输入参数:
//////输出参数:
//////说		明：
//////////////////////////////////////////////////////////////////////////////
UINT8_T  USARTTask_GetReadState(USART_HandlerType* USARTx)
{
	return USARTLib_GetReadState(USARTx);
}

///////////////////////////////////////////////////////////////////////////////
//////函		数：
//////功		能：
//////输入参数:
//////输出参数:
//////说		明：
//////////////////////////////////////////////////////////////////////////////
UINT8_T  USARTTask_ClearReadState(USART_HandlerType* USARTx)
{
	return USARTLib_ClearReadState(USARTx);
}

///////////////////////////////////////////////////////////////////////////////
//////函		数：
//////功		能：
//////输入参数:
//////输出参数:
//////说		明：
//////////////////////////////////////////////////////////////////////////////
UINT8_T  USARTTask_GetWriteState(USART_HandlerType* USARTx)
{
	return USARTLib_GetWriteState(USARTx);
}

///////////////////////////////////////////////////////////////////////////////
//////函		数：
//////功		能：
//////输入参数:
//////输出参数:
//////说		明：
//////////////////////////////////////////////////////////////////////////////
UINT8_T  USARTTask_ClearWriteState(USART_HandlerType* USARTx)
{
	return USARTLib_ClearWriteState(USARTx);
}

///////////////////////////////////////////////////////////////////////////////
//////函		数：
//////功		能：
//////输入参数:
//////输出参数:
//////说		明：
//////////////////////////////////////////////////////////////////////////////
UINT8_T  USARTTask_TimeOVFTask(USART_HandlerType*USARTx)
{
	return  USARTLib_TimeOVFTask(USARTx);
}

///////////////////////////////////////////////////////////////////////////////
//////函		数：
//////功		能：
//////输入参数:
//////输出参数:
//////说		明：
//////////////////////////////////////////////////////////////////////////////
UINT8_T  USARTTask_Read8BitsCount_Task(USART_HandlerType*USARTx, UINT8_T val)
{
	return USARTLib_Read8BitsCount_Task(USARTx, val);
}

///////////////////////////////////////////////////////////////////////////////
//////函		数：
//////功		能：
//////输入参数:
//////输出参数:
//////说		明：
//////////////////////////////////////////////////////////////////////////////
UINT8_T  USARTTask_Read16BitsCount_Task(USART_HandlerType*USARTx, UINT8_T val)
{
	return USARTLib_Read16BitsCount_Task(USARTx, val);
}

///////////////////////////////////////////////////////////////////////////////
//////函		数：
//////功		能：
//////输入参数:
//////输出参数:
//////说		明：
//////////////////////////////////////////////////////////////////////////////
UINT8_T  USARTTask_ReadInit(USART_HandlerType*  USARTx)
{
	return USARTLib_ReadInit(USARTx);
}
///////////////////////////////////////////////////////////////////////////////
//////函		数：
//////功		能：
//////输入参数:
//////输出参数:
//////说		明：
//////////////////////////////////////////////////////////////////////////////
UINT8_T  USARTTask_ITWrite_TXETask(USART_HandlerType*USARTx)
{
	return USARTLib_ITWrite_TXETask(USARTx);
}

///////////////////////////////////////////////////////////////////////////////
//////函		数：
//////功		能：
//////输入参数:
//////输出参数:
//////说		明：
//////////////////////////////////////////////////////////////////////////////
UINT8_T  USARTTask_ITWrite_TCTask(USART_HandlerType*USARTx)
{
	return USARTLib_ITWrite_TCTask(USARTx);
}

///////////////////////////////////////////////////////////////////////////////
//////函		数：
//////功		能：
//////输入参数:
//////输出参数:
//////说		明：
//////////////////////////////////////////////////////////////////////////////
UINT8_T USARTTask_AddWriteByte(USART_HandlerType*USARTx, UINT8_T val, UINT8_T isNeedID)
{
	return  USARTLib_AddWriteByte(USARTx, val, isNeedID);
}

///////////////////////////////////////////////////////////////////////////////
//////函		数：
//////功		能：
//////输入参数:
//////输出参数:
//////说		明：
//////////////////////////////////////////////////////////////////////////////
UINT8_T USARTTask_AddWriteData(USART_HandlerType*USARTx, UINT8_T *pVal, UINT16_T length, UINT8_T isNeedID)
{
	return  USARTLib_AddWriteData(USARTx, pVal, length, isNeedID);
}
///////////////////////////////////////////////////////////////////////////////
//////函		数：
//////功		能：
//////输入参数:
//////输出参数:
//////说		明：
//////////////////////////////////////////////////////////////////////////////
UINT8_T  USARTTask_CRCTask(USART_HandlerType*USARTx, UINT16_T *pCount)
{
	return USARTLib_CRCTask(USARTx, pCount);
}
///////////////////////////////////////////////////////////////////////////////
//////函		数：
//////功		能：
//////输入参数:
//////输出参数:
//////说		明：
//////////////////////////////////////////////////////////////////////////////
UINT8_T USARTTask_WriteSTART(USART_HandlerType*USARTx, UINT8_T isNeedID)
{
	return USARTLib_WriteSTART(USARTx, isNeedID);
}

///////////////////////////////////////////////////////////////////////////////
//////函		数：
//////功		能：
//////输入参数:
//////输出参数:
//////说		明：
//////////////////////////////////////////////////////////////////////////////
UINT8_T USARTTask_SendByte(USART_HandlerType*USARTx, UINT8_T  val)
{
	return USARTLib_SendByte(USARTx, val);
}

///////////////////////////////////////////////////////////////////////////////
//////函		数：
//////功		能：
//////输入参数:
//////输出参数:
//////说		明：
//////////////////////////////////////////////////////////////////////////////
UINT8_T USARTTask_SendString(USART_HandlerType*USARTx, char *pVal)
{
	return  USARTLib_SendString(USARTx, pVal);
}

///////////////////////////////////////////////////////////////////////////////
//////函		数：
//////功		能：
//////输入参数:
//////输出参数:
//////说		明：
//////////////////////////////////////////////////////////////////////////////
UINT8_T USARTTask_FuncTask(USART_HandlerType*USARTx, UINT8_T(*pFuncTask)(UINT8_T *, UINT8_T *))
{
	UINT16_T length = 0;
	if (USARTx != NULL)
	{
		//---判断接收是否完成
		if (USARTTask_GetReadState(USARTx) == 1)
		{
			//---CRC的校验
			if (USARTTask_CRCTask(USARTx, &length) == OK_0)
			{
				//---数据接收完成
				if (pFuncTask != NULL)
				{
					pFuncTask(USARTx->msgRxHandler.pMsgVal, USARTx->msgTxHandler.pMsgVal);
				}
				else
				{
					USARTTask_AddWriteData(USARTx, USARTx->msgRxHandler.pMsgVal, length, 0);
				}
				USARTTask_WriteSTART(USARTx, 1);
			}
			else
			{
				//---发生CRC校验错误
				USART_Printf(USARTx, "=>>串口%d:发生CRC校验错误<<=\r\n", (USARTx->msgIndex - 1));
			}
			return USARTTask_ReadInit(USARTx);
		}
		return USARTTask_TimeOVFTask(USARTx);
	}
	return ERROR_2;
}