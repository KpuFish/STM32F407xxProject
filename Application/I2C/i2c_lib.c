#include "i2c_lib.h"

///////////////////////////////////////////////////////////////////////////////
//////函		数：
//////功		能：
//////输入参数:
//////输出参数:
//////说		明：
//////////////////////////////////////////////////////////////////////////////
UINT8_T I2CLib_MSW_Init(I2C_HandlerType *I2CxHandlerType, void(*msgDelay)(UINT32_T delay))
{
	I2C_HandlerType_Init(I2CxHandlerType);
	return I2C_MSW_Init(I2CxHandlerType, msgDelay);
}

///////////////////////////////////////////////////////////////////////////////
//////函		数：
//////功		能：
//////输入参数:
//////输出参数:
//////说		明：
//////////////////////////////////////////////////////////////////////////////
UINT8_T I2CLib_MSW_DeInit(I2C_HandlerType *I2CxHandlerType)
{
	return I2C_MSW_DeInit(I2CxHandlerType);
}

///////////////////////////////////////////////////////////////////////////////
//////函		数：
//////功		能：
//////输入参数:
//////输出参数:
//////说		明： 返回的是应答信号
//////////////////////////////////////////////////////////////////////////////
UINT8_T I2CLib_MSW_START(I2C_HandlerType *I2CxHandlerType, UINT8_T isWrite)
{
	//---发送启动信号
	I2C_MSW_START(I2CxHandlerType);
	//---判断是读取操作还是写入操作
	if (isWrite)
	{
		I2CxHandlerType->msgAddr &= 0xFE;
	}
	else
	{
		I2CxHandlerType->msgAddr |= 0x01;
	}
	//---发送从机地址
	I2C_MSW_SendByte(I2CxHandlerType, ( UINT8_T )I2CxHandlerType->msgAddr);
	//---读取应答信号
	return I2C_MSW_ReadACK(I2CxHandlerType);
}

///////////////////////////////////////////////////////////////////////////////
//////函		数：
//////功		能：
//////输入参数:
//////输出参数:
//////说		明：
//////////////////////////////////////////////////////////////////////////////
UINT8_T I2CLib_MSW_STOP(I2C_HandlerType *I2CxHandlerType)
{
	//---发送启动信号
	return	I2C_MSW_STOP(I2CxHandlerType);
}

///////////////////////////////////////////////////////////////////////////////
//////函		数：
//////功		能：
//////输入参数:
//////输出参数:
//////说		明：
//////////////////////////////////////////////////////////////////////////////
UINT8_T I2CLib_MSW_ACK(I2C_HandlerType *I2CxHandlerType)
{
	return I2C_MSW_ACK(I2CxHandlerType);
}

///////////////////////////////////////////////////////////////////////////////
//////函		数：
//////功		能：
//////输入参数:
//////输出参数:
//////说		明：
//////////////////////////////////////////////////////////////////////////////
UINT8_T I2CLib_MSW_NACK(I2C_HandlerType *I2CxHandlerType)
{
	return I2C_MSW_NACK(I2CxHandlerType);
}

///////////////////////////////////////////////////////////////////////////////
//////函		数：
//////功		能：
//////输入参数:
//////输出参数:
//////说		明：
//////////////////////////////////////////////////////////////////////////////
UINT8_T I2CLib_MSW_ReadACK(I2C_HandlerType *I2CxHandlerType)
{
	return I2C_MSW_ReadACK(I2CxHandlerType);
}

///////////////////////////////////////////////////////////////////////////////
//////函		数：
//////功		能：
//////输入参数:
//////输出参数:
//////说		明：
//////////////////////////////////////////////////////////////////////////////
UINT8_T I2CLib_MSW_WaitACK(I2C_HandlerType *I2CxHandlerType)
{
	return I2C_MSW_WaitACK(I2CxHandlerType);
}

///////////////////////////////////////////////////////////////////////////////
//////函		数：
//////功		能：
//////输入参数:
//////输出参数:
//////说		明：
//////////////////////////////////////////////////////////////////////////////
UINT8_T I2CLib_MSW_SendACK(I2C_HandlerType *I2CxHandlerType, UINT8_T isNACK)
{
	return I2C_MSW_SendACK(I2CxHandlerType, isNACK);
}

///////////////////////////////////////////////////////////////////////////////
//////函		数：
//////功		能：
//////输入参数:
//////输出参数:
//////说		明：
//////////////////////////////////////////////////////////////////////////////
UINT8_T I2CLib_MSW_SendByte(I2C_HandlerType *I2CxHandlerType, UINT8_T val)
{
	return I2C_MSW_SendByte(I2CxHandlerType, val);
}

///////////////////////////////////////////////////////////////////////////////
//////函		数：
//////功		能：
//////输入参数:
//////输出参数:
//////说		明：
//////////////////////////////////////////////////////////////////////////////
UINT8_T I2CLib_MSW_SendBits(I2C_HandlerType *I2CxHandlerType, UINT8_T *pVal, UINT8_T bitNum)
{
	return I2C_MSW_SendBits(I2CxHandlerType, pVal, bitNum);
}

///////////////////////////////////////////////////////////////////////////////
//////函		数：
//////功		能：
//////输入参数:
//////输出参数:
//////说		明：
//////////////////////////////////////////////////////////////////////////////
UINT8_T I2CLib_MSW_ReadByte(I2C_HandlerType *I2CxHandlerType)
{
	return I2C_MSW_ReadByte(I2CxHandlerType);
}

///////////////////////////////////////////////////////////////////////////////
//////函		数：
//////功		能：
//////输入参数:
//////输出参数:
//////说		明：
//////////////////////////////////////////////////////////////////////////////
UINT8_T I2CLib_MSW_ReadBits(I2C_HandlerType *I2CxHandlerType, UINT8_T *pVal, UINT8_T bitNum)
{
	return I2C_MSW_ReadBits(I2CxHandlerType, pVal, bitNum);
}

///////////////////////////////////////////////////////////////////////////////
//////函		数：
//////功		能：
//////输入参数:
//////输出参数:
//////说		明：
//////////////////////////////////////////////////////////////////////////////
UINT8_T I2CLib_MSW_SendCMD(I2C_HandlerType *I2CxHandlerType, UINT8_T cmd, UINT8_T isStart, UINT8_T isStop)
{
	return I2C_MSW_SendCMD(I2CxHandlerType, cmd, isStart, isStop);
}

///////////////////////////////////////////////////////////////////////////////
//////函		数：
//////功		能：
//////输入参数:
//////输出参数:
//////说		明：
//////////////////////////////////////////////////////////////////////////////
UINT8_T I2CLib_MSW_Send(I2C_HandlerType *I2CxHandlerType, UINT8_T *pVal, UINT16_T length)
{
	UINT8_T _return = OK_0;
	UINT16_T i = 0;
	//---发送启动信号并发送从机地址---写地址
	_return = I2CLib_MSW_START(I2CxHandlerType, 1);
	//---判断启动信号是否成功并同时决定是否发送数据
	if (_return == 0)
	{
		for (i = 0; i < length; i++)
		{
			//---发送数据
			I2CLib_MSW_SendByte(I2CxHandlerType, pVal[i]);
			//---读取应答信号
			_return = I2CLib_MSW_ReadACK(I2CxHandlerType);
			//---判断应答信号
			if (_return)
			{
				_return = (2 + i);
				break;
			}
		}
	}
	return _return;
}

///////////////////////////////////////////////////////////////////////////////
//////函		数：
//////功		能：
//////输入参数:
//////输出参数:
//////说		明：
//////////////////////////////////////////////////////////////////////////////
UINT8_T I2CLib_MSW_Read(I2C_HandlerType *I2CxHandlerType, UINT8_T *pVal, UINT16_T length)
{
	UINT8_T _return = OK_0;
	UINT16_T i = 0;
	//---发送启动信号并发送从机地址---写地址
	_return = I2CLib_MSW_START(I2CxHandlerType, 1);
	//---判断启动信号是否成功并同时决定是否发送数据
	if (_return != OK_0)
	{
		goto GotoExit;
	}
	//---发送启动信号并发送从机地址---读取地址
	_return = I2CLib_MSW_START(I2CxHandlerType, 0);
	//---判断启动信号是否成功并同时决定是否发送数据
	if (_return != OK_0)
	{
		_return = ERROR_2;
		goto GotoExit;
	}
	for (i = 0; i < length; i++)
	{
		//---读取数据
		pVal[i] = I2CLib_MSW_ReadByte(I2CxHandlerType);
		if ((length - 1) == i)
		{
			_return = ERROR_3;
		}
		//---发送应答信号或则不应答信号
		I2CLib_MSW_SendACK(I2CxHandlerType, _return);
	}
	_return = OK_0;
GotoExit:
	return _return;
}